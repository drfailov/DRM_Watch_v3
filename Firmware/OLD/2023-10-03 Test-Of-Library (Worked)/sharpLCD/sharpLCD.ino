#define SCLK 12
#define SI 11
#define SCS 10

#define EXTC 9
//#define EXTC 3

void sendData(unsigned char data)
{
  unsigned char tmp = 0;
    for (unsigned char j = 0; j < 8; j++) {
      tmp = data & 0x01;
      if (tmp == 1)
      {      
        digitalWrite(SI, HIGH);
      } else {
        digitalWrite(SI, LOW);
      }
      delayMicroseconds(1);
      digitalWrite(SCLK, HIGH);
      digitalWrite(SCLK, LOW);
      data = data >> 1;
    }
}


void sendData(unsigned char datalen, unsigned char* data)
{
  for (unsigned char i = 0; i < datalen;i++) {
    unsigned char d = data[i];
    sendData(d);
  }
  digitalWrite(SCLK, LOW);
}

void clearLCD()
{
    digitalWrite(SCS, HIGH);
    unsigned char clearData[2] = {
      0b00000110, 0b00000000
      };
    sendData(2, clearData);
    delayMicroseconds(1);
    digitalWrite(SCS, LOW);
}

const unsigned char cmdWriteOneLineTodisplay = 0b00000010; // L display mode;
const unsigned char cmdWriteOneLineToMemory =  0b00000011; // H memory mode;

void writeOneLine(unsigned char line_num, unsigned char* line_data)
{
  digitalWrite(SCS, HIGH);
  sendData(cmdWriteOneLineToMemory);
  sendData(line_num);
  sendData(50, line_data);
  // 16 clk dummy data
  sendData(0b00000000);
  sendData(0b00000000);
  delayMicroseconds(1);
  digitalWrite(SCS, LOW);
}

void writeMutLine(unsigned char* line, unsigned char line_num, unsigned char** line_data)
{
  digitalWrite(SCS, HIGH);

  sendData(cmdWriteOneLineToMemory);
  for (unsigned char line_index = 0; line_index < line_num; line_index++) {
    unsigned char curLine = line[line_index];
    sendData(curLine);
    sendData(50, line_data[line_index]);
    sendData(0b00000000);
  }
  // 16 clk dummy data
  sendData(0b00000000);
  sendData(0b00000000);
  delayMicroseconds(1);
  digitalWrite(SCS, LOW);
}

void writeImage(unsigned char data[][50])
{
  digitalWrite(SCS, HIGH);

  sendData(cmdWriteOneLineToMemory);
  for (unsigned char curLine = 0; curLine < 240; curLine++) {
    sendData(curLine + 1);
    sendData(50, data[curLine]);
    sendData(0b00000000);
  }
  // 16 clk dummy data
  sendData(0b00000000);
  sendData(0b00000000);
  delayMicroseconds(1);
  digitalWrite(SCS, LOW);
}

void setup() {
  Serial.begin(9600);

  // put your setup code here, to run once:
  pinMode(SI, OUTPUT);
  pinMode(SCLK, OUTPUT);
  pinMode(SCS, OUTPUT);
  pinMode(EXTC, OUTPUT);
  
  delayMicroseconds(50); 
  //TCCR2B = TCCR2B & B11111000 | B00000111;    // set timer 2 divisor to  1024 for PWM frequency of    30.64 Hz
  clearLCD();
  analogWrite(EXTC, 127);
}
  const unsigned char data[12000] PROGMEM = {
0 , 0 , 0 , 168 , 170 , 170 , 170 , 170 , 170 , 42 , 34 , 186 ,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 0 ,
0 , 0 , 0 , 84 , 85 , 68 , 68 , 68 , 0 , 0 , 0 , 80 ,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 0 ,
0 , 0 , 0 , 168 , 170 , 170 , 170 , 170 , 170 , 138 , 0 , 184 ,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 0 ,
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0 , 0 , 0 , 0 , 64 , 85 , 85 , 85 , 221 , 213 , 85 , 85 ,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 0 
};

void loop() {
//   put your main code here, to run repeatedly:

  clearLCD();
  analogWrite(EXTC, 0);
  delay(500);

  digitalWrite(SCS, HIGH);

  sendData(cmdWriteOneLineToMemory);
  for (unsigned char curLine = 0; curLine < 240; curLine++) {
    sendData(curLine + 1);
    for (unsigned char curRow = 0; curRow < 50; curRow++) {
      unsigned char tmp = ~pgm_read_byte(&data[curLine*50 + curRow]);
      sendData(tmp);
    }
    sendData(0b00000000);
  }
  // 16 clk dummy data
  sendData(0b00000000);
  sendData(0b00000000);
  delayMicroseconds(1);
  digitalWrite(SCS, LOW);
  analogWrite(EXTC, 127);
  
  delay(1000);
}
