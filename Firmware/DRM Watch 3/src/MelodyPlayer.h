#ifndef MELODYPLAYER_H
#define MELODYPLAYER_H

/*PROTOTYPPES*/
int melodyPlayerGetLength(const int* melody);
bool melodyPlayerProcessButtons(bool alarm);
void melodyPlayerDrawScreen(bool alarm);
const char* getMelodyNameC(int index);
String getMelodyName(int index);

#include "Lcd.h"
#include "Led.h"
#include "Backlight.h"
#include "Buzzer.h"
#include "Button.h"
#include "Icons.h"
#include "AutoSleep.h"
#include "ModeTimer.h"
#include "ModeWatchface.h"


const int alert1[]={1900, -50, -70, 1900, -50, -70, 1900, -50, -70, 1900, -50, -500, /*||*/ 1900, -50, -70, 1900, -50, -70, 1900, -50, -70, 1900, -50, -500, /*||*/ 1900, -50, -70, 1900, -50, -70, 1900, -50, -70, 1900, -50, -500, /*||*/ 1900, -50, -70, 1900, -50, -70, 1900, -50, -70, 1900, -50, -500, /*||*/ 1900, -50, -70, 1900, -50, -70, 1900, -50, -70, 1900, -50, -500, /*||*/ 1900, -50, -70, 1900, -50, -70, 1900, -50, -70, 1900, -50, -500, /*||*/ 1900, -50, -70, 1900, -50, -70, 1900, -50, -70, 1900, -50, -500, /*||*/ 1900, -50, -70, 1900, -50, -70, 1900, -50, -70, 1900, -50, -500, /*||*/ 1900, -50, -70, 1900, -50, -70, 1900, -50, -70, 1900, -50, -500, /*||*/ 1900, -50, -70, 1900, -50, -70, 1900, -50, -70, 1900, -50, -500, /*||*/ 1900, -50, -70, 1900, -50, -70, 1900, -50, -70, 1900, -50, -500, /*||*/ 1900, -50, -70, 1900, -50, -70, 1900, -50, -70, 1900, -50,  19};
const int alert2[]={1900, -100, 2400, -100, 1900, -100, 2400, -100, 1900, -100, 2400, -100, 1900,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 -500, 19};
const int badinerie[]={988, -241, 1175, -118, 988, -118, 740, -241, 988, -118, 740, -118, 587,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 -833, 19};
const int nokiaTune[]={1558, -133, 1388, -133, 874, -267, 981, -267, 1310, -133, 1167, -133, 694, -267, 779, -267, 1167, -133, 1040, -133, 655, -267, 779, -267, 1040, -1071, 19};
const int groovyBlue[]={1388, -120, -1920, 1040, -120, 1236, -120, 1040, -120, 1236, -120, 1388, -120,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 -240, 19};
const int ukraine[]={554, -248, -116, 554, -332, -23, 494, -325, -30, 554, -267, -85, 587,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 -1330, 19};
const int blindinglights[]={698, -678, 698, -508, -28, 622, -169, 698, -169, 784, -339, -18, 523,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 -1526, 19};
const int wasWollenWirTrinken[]={1175, -74, -171, 1175, -94, -25, 1047, -126, 988, -117, -132, 1047, -213,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 -99, 19};
const int toreador[]={1040, -363, 1167, -363, 1040, -90, 874, -363, 874, -363, 874, -181, -90,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 -727, 19};
const int blue[]={440, -448, 466, -224, 294, -224, 392, -224, 466, -224, 523, -224, 349,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 -224, 19};
const int nyancat[]={740, -214, 831, -107, -108, 554, -107, 622, -214, 494, -54, -53, 587,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 -214, 19};
const int rollon[]={880, -273, 932, -273, 1047, -273, 1245, -554, 880, -554, 932, -554, 880,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 -1113, 19};
const int entertainer[]={1175, -167, 1319, -167, 1047, -167, 880, -333, 988, -167, 784, -333, 587,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 -167, 19};
const int stillalive[]={784, -250, 740, -250, 659, -250, 659, -250, 740, -250, -2500, 440, -250,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 -500, 19};
const int mario[]={659, -95, 659, -95, -191, 659, -95, -190, 523, -95, -48, 659, -95,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 -95, 19};
const int espionage[]={880, -14, -241, 880, -34, -220, 1047, -38, -89, 880, -23, -231, 1760,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 -169, 19};
const int swimming[]={932, -107, 370, -107, 740, -107, 831, -107, 370, -107, 932, -107, 370,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 -107, 19};
const int trance[]={523, -107, 784, -102, -112, 523, -107, 784, -103, -111, 523, -107, 784,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 -107, 19};
const int crazyfrog[]={349, -113, 415, -97, -278, 349, -83, -167, 349, -99, -26, 466, -81,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 -1396, 19};
const int shapeofmyheart[]={784, -342, 330, -195, 494, -381, 784, -348, 294, -184, 740, -363, 294,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 -937, 19};
const int gta[]={392, -313, 311, -313, 294, -156, 311, -156, 294, -156, 262, -156, 294,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 -313, 19};
const int popcorn[]={988, -88, -139, 880, -78, -149, 988, -76, -151, 740, -59, -169, 587,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 -52, 19};
const int jojo[]={740, -667, 587, -778, -111, 587, -111, 659, -111, 698, -333, 659, -333,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 -222, 19};
const int carol[]={466, -83, -251, 440, -83, -83, 466, -83, -84, 392, -83, -250, 466,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 -83, 19};
const int missionimpossible[]={196, -167, 196, -167, -333, 233, -167, -166, 262, -167, -167, 196, -167,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 -167, 19};
const int maxwell[]={1175, -115, 1175, -115, -116, 1175, -115, -115, 1319, -231, 1397, -231, -231,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 -231, 19};
const int jinglebells[]={440, -136, -137, 440, -136, -137, 440, -136, -409, 440, -136, -137, 440,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 -136, 19};
const int harrypotter[]={247, -167, -167, 330, -167, -333, 392, -167, 370, -167, -167, 330, -167,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 -167, 19};
const int GameOfThrones[]={392, -359, 262, -359, 311, -180, 349, -180, 392, -359, 262, -359, 311,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 -180, 19};
const int believer[]={220, -480, 330, -480, 294, -240, -252, 294, -240, -58, 262, -120, -55,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 -120, 19};
const int xfiles[]={220, -136, 262, -136, 330, -136, 349, -136, 262, -136, 330, -136, 349,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 -136, 19};
const int sleighride[]={294, -150, -150, 294, -150, -150, 294, -150, -150, 294, -150, -150, 330,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 -150, 19};
const int sobak[]={698, -299, -122, 659, -179, -171, 698, -867, -605, 587, -334, -87, 659,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 -380, 19};
const int chiquitita[]={415, -188, 831, -188, 415, -188, 831, -188, 415, -188, 831, -188, 415,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 -188, 19};
const int astronomia[]={494, -238, 440, -238, 415, -238, 330, -238, 370, -476, 370, -238, 554,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 -1905, 19};
const int cossacmarch[]={587, -711, 440, -117, 587, -117, 698, -711, -39, 587, -117, 698, -117,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 -124, 19};
const int polskakorivka[]={330, -124, 330, -124, -124, 440, -124, -124, 440, -124, -124, 330, -124,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 -124, 19};
const int crabrave[]={466, -231, 392, -231, 392, -115, 294, -231, 294, -115, 440, -231, 349,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 -231, 19};
const int angrybirds[]={330, -136, 370, -136, 392, -136, -137, 330, -136, -137, 247, -136, -137,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 -136, 19};
const int bennyhill[]={587, -321, 659, -107, 784, -143, -71, 784, -143, -71, 659, -107, 587,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 -214, 19};
const int newergonnagiveyouup[]={698, -692, 784, -692, 523, -462, 784, -692, 880, -692, 1047, -115, 932,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 -462, 19};
const int funkytown[]={262, -120, -120, 262, -120, -120, 233, -120, -120, 262, -120, -360, 196,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 -120, 19};
const int dogwaltz[]={1245, -136, 1109, -136, 740, -136, -136, 1480, -136, -137, 1480, -136, -137,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 -273, 19};
//----------------------//----------------------//----------------------//----------------------//----------------------//----------------------//----------------------



struct Melody {             
  String name;   
  const int* data;         
  Melody(String _name, const int* _data):name(_name), data(_data) {}
  Melody(String _name, const byte* _data):name(_name), data((const int*)_data) {}
};    

Melody melodies[]={   //відсортовано по алфавіту
  {"Alert Timer 1", alert1},
  {"Alert Timer 2", alert2},
  {"Angry Birds", angrybirds},
  {"Astronomia", astronomia},
  {"Badinerie", badinerie},
  {"Believer", believer},
  {"Benny Hill", bennyhill},
  {"Blinding Lights", blindinglights},
  {"Blue", blue},
  {"Chiquitita", chiquitita},
  {"Crab Rave", crabrave},
  {"Crazy Frog", crazyfrog},
  {"Dog Waltz", dogwaltz},
  {"Entertainer", entertainer},
  {"Espionage", espionage},
  {"Funkytown", funkytown},
  {"Game Of Thrones", GameOfThrones},
  {"Groovy Blue", groovyBlue},
  {"GTA", gta},
  {"Harry Potter", harrypotter},
  {"Jingle Bells", jinglebells},
  {"Jojo", jojo},
  {"Maxwell The Cat", maxwell},
  {"Mission Impossible", missionimpossible},
  {"Newer Gonna Give You Up", newergonnagiveyouup},  
  {"Nokia Tune", nokiaTune},  
  {"Nyan Cat", nyancat},
  {"Popcorn", popcorn},
  {"Roll On", rollon},
  {"Shape of my heart", shapeofmyheart},
  {"Sobak", sobak},
  {"Sleigh Ride", sleighride},
  {"Still Alive", stillalive},
  {"Swimming", swimming},
  {"Toreador", toreador},
  {"Trance", trance},
  {"X-Files", xfiles},
  {"Was Woller Wir Trinken", wasWollenWirTrinken},
  {"Гімн України", ukraine},
  {"Koзaцький Mapш", cossacmarch},
  {"Mapio", mario},
  {"Польська Корівка", polskakorivka},
  {"Щедрик", carol}
};

int getMelodyCount(){
   return sizeof(melodies)/sizeof(melodies[0]);
}

const char* getMelodyNameC(int index)
{
   return melodies[index].name.c_str();
}
String getMelodyName(int index)
{
   return melodies[index].name;
}

const int* getMelodyData(int index)
{
   return melodies[index].data;
}





bool melodyPlayerLoopMelody = false;   
String melodyPlayerMelodyName;
unsigned long melodyPlayerPlayStarted = 0;

void melodyPlayerSetMelodyName(String _name){
  melodyPlayerMelodyName=_name;
}
//return true if was played completely or false if interrupted
bool melodyPlayerPlayMelody(const int* melody, bool alarm) {
  Serial.println(F("Open: PlayMelody"));
  clearScreenAnimation();
  backlightOn();
  melodyPlayerPlayStarted = millis();
  //modeLoop = melodyPlayerDrawScreen;
  modeButtonUp = 0;
  modeButtonCenter = 0;
  modeButtonDown = 0;
  modeButtonUpLong = 0;
  modeButtonCenterLong = 0;
  modeButtonDownLong = 0;
  enableAutoReturn = false;
  melodyPlayerLoopMelody = false;
  
  int length = melodyPlayerGetLength(melody);
  Serial.print("length="); Serial.println(length);
  int prequencyThreshold = 0;
  {//analyze melody
    long noteSum = 0;
    long noteCnt = 0;
    for (int i = 1; i < length-1; i++) {
      int n = (melody[i]);
      if (n > 0){
        noteSum += n;
        noteCnt ++;
      }
    }
    prequencyThreshold = 100 + noteSum/noteCnt;
    Serial.print("frequencyThreshold="); Serial.println(prequencyThreshold);
  }
  do{
    melodyPlayerDrawScreen(alarm);
    for (int i = 0; i < length-1; i++) {
      int note = (melody[i]);
      if(note > 0){ //it's frequency
        buzTone(note);
        if(note>prequencyThreshold)
          ledFlashlightOnBottom();
        else
          ledFlashlightOnTop();
      }
      if(note < 0){ //it's time
        for(unsigned long noteStarted = millis(); millis() - noteStarted < (-note); ) {
          if((millis() - noteStarted)+150 < (-note)){
            if(melodyPlayerProcessButtons(alarm)) 
              return false; //false = melody interrupted
            melodyPlayerDrawScreen(alarm);
          }
        }
        if(melodyPlayerProcessButtons(alarm)) 
          return false; //false = melody interrupted
        ledFlashlightOffAll();
        buzNoTone();
      }  
    }
    delay(500);
  }while(melodyPlayerLoopMelody);
  if(!alarm) modeSetup();
  return true;
}

//returns true if user stopped playing
bool melodyPlayerProcessButtons(bool alarm){
  if(isButtonCenterPressed())
  {
    buttonBeep(); 
    modeSetup(); 
    ledFlashlightOffAll(); 
    while(isButtonCenterPressed()); 
    return true;
  }
  if(alarm){
    if(!isTimerRunning())
    {  
      if(isButtonUpPressed())
      {
        buttonBeep(); 
        modeSetup(); 
        setTimerToMinutes(10); 
        drawMessage("Відкладено на 10 хвилин");  
        ledFlashlightOffAll(); 
        buzNoTone();
        while(isButtonUpPressed()); 
        return true;
      }
      if(isButtonDownPressed())
      {
        buttonBeep(); 
        modeSetup(); 
        setTimerToMinutes(5); 
        drawMessage("Відкладено на 5 хвилин");  
        ledFlashlightOffAll(); 
        buzNoTone();
        while(isButtonDownPressed()); 
        return true;
      }
    }
  }
  else{
    if(isButtonDownPressed())
    {
      buttonBeep(); 
      melodyPlayerLoopMelody = !melodyPlayerLoopMelody; 
      drawMessage(melodyPlayerLoopMelody?"Повтор увімкнено":"Вимкнено повтор");  
      while(isButtonDownPressed()); 
    }
  }
  return false;
}

void melodyPlayerDrawScreen(bool alarm) {

  lcd()->setColorIndex(white);
  lcd()->drawBox(0, 0, 400, 240);

  lcd()->setFont(u8g2_font_10x20_t_cyrillic);  //ok
  lcd()->setCursor(5, 18); 
  lcd()->setColorIndex(black);
  if(alarm)
    lcd()->print("Сповіщення");
  else
    lcd()->print("Плеєр");
  
  int x = drawStatusbar(363, 1, true); 
  if(melodyPlayerLoopMelody)      //draw repeat icon next to statusbar
    draw_ic16_repeat(x-16, 5, black);
  

  displayDrawVector(getPathZubat(), 130, 45, 3.0, 3, false, black);
  
  lcd()->setFont(u8g2_font_10x20_t_cyrillic);  //ok
  lcd()->setCursor(5, 230); 
  int sec = (millis()-melodyPlayerPlayStarted)/1000;
  if(sec < 10)
    lcd()->print("0");
  lcd()->print(sec);
  lcd()->print("s");

  drawCentered(melodyPlayerMelodyName, 200);

  lcd()->drawBox(369, 0, 2, 260);  //draw_ic16_repeat  draw_ic16_arrow_right  draw_ic16_back
  if(alarm){
    draw_ic16_back(lx(), ly2(), black);
    if(!isTimerRunning()){  
      lcd()->setFont(u8g2_font_unifont_t_cyrillic); //smalll 
      lcd()->setCursor(lx()-5, ly1()+16); lcd()->print("+10");
      lcd()->setCursor(lx()-1, ly3()+16); lcd()->print("+5");
    }
  }
  else{
    draw_ic16_back(lx(), ly2(), black);
    draw_ic16_repeat(lx(), ly3(), black);
  }
  lcd()->sendBuffer();
}

void printBits(byte myByte) {
  for (byte mask = 0x80; mask; mask >>= 1) {
    if (mask & myByte)
      Serial.print('1');
    else
      Serial.print('0');
  }
}

int melodyPlayerGetLength(const int* melody) {
  for (int i = 0; i < 5000; i++) {
    //Serial.print("i="); Serial.println(i);
    int b = (melody[i]);
    if (b == 19) { //EOF
      return i + 1;
    }
  }
  return 5000;
}

















#endif